VERSION ""

NS_ :

BS_:

BU_:

BO_ 2321524218 Cnt_A5FA5FA: 8 Vector__XXX
 SG_ Counts_Comp_A5FA5FA : 24|8@1+ (1,0) [0|255] "" Vector__XXX
 SG_ Counts_A5FA5FA : 16|8@1+ (1,0) [0|255] "Ticks" Vector__XXX

BO_ 1537 Cnt_601: 8 Vector__XXX
 SG_ Counts_Comp_601 : 24|8@1+ (1,0) [0|255] "" Vector__XXX
 SG_ Counts_601 : 16|8@1+ (1,0) [0|255] "Ticks" Vector__XXX

BO_ 1281 Cnt_501: 8 Vector__XXX
 SG_ Counts_Comp_501 : 24|8@1+ (1,0) [0|255] "" Vector__XXX
 SG_ Counts_501 : 16|8@1+ (1,0) [0|255] "Ticks" Vector__XXX

BO_ 2321524219 Cnt_A5FA5FB: 8 Vector__XXX
 SG_ Counts_Comp_A5FA5FB : 24|8@1+ (1,0) [0|255] "" Vector__XXX
 SG_ Counts_A5FA5FB : 16|8@1+ (1,0) [0|255] "Ticks" Vector__XXX

BO_ 1536 Cnt_600: 8 Vector__XXX
 SG_ Counts_Comp_600 : 24|8@1+ (1,0) [0|255] "" Vector__XXX
 SG_ Counts_600 : 16|8@1+ (1,0) [0|255] "Ticks" Vector__XXX

BO_ 1280 Cnt_500: 8 Vector__XXX
 SG_ Counts_Comp_500 : 24|8@1+ (1,0) [0|255] "" Vector__XXX
 SG_ Counts_500 : 16|8@1+ (1,0) [0|255] "Ticks" Vector__XXX
